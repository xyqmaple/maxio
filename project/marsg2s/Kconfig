## project/marsg2s/Kconfig
```kconfig
mainmenu "MarsG2x Global Configuration List"

menu "General setup"

choice
	bool "Architecture"
	default ARM_64

config ARM_32
	bool "ARM32"

config ARM_64
	bool "ARM64"
	select LITTLE_ENDIAN
	select ARCH_USE_BUILTIN_BSWAP

endchoice

choice
	bool "Platform Environment"
	default PLAT_ASIC

config PLAT_COSIM
	bool "Cosim"

config PLAT_FPGA
	bool "FPGA"

config PLAT_ASIC
	bool "ASIC"

endchoice

choice
	bool "Board Environment"
	default MAXIO

config MAXIO
	bool "Maxio EVB"

config HIKVISION
	bool "Hikvision EVB"

endchoice

config LITTLE_ENDIAN
	bool

config ARCH_USE_BUILTIN_BSWAP
	bool

config DMA_ALIGN
	int "DMA address requres aligned size"
	default 8 if ARM_64
	default 4 if ARM_32

endmenu

source "src/lib/Kconfig"
source "src/sys/Kconfig"
```

## project/marsg2s/src/sys/Kconfig
```kconfig
menu "System Configuration"

source "src/sys/cpu/Kconfig"
source "src/sys/usb/Kconfig"

endmenu
```

## project/marsg2s/src/sys/usb/board/Kconfig
```kconfig
menu "Test for Other Modules on the Board" 

config USB_FOR_LPC_TEST
	bool "Support Low Power Control Test"
	depends on USB_HOST

config USB_FOR_TRUSTZONE_TEST
	bool "Supoort TrustZone Test"
	depends on USB_HOST

config USB_FOR_MISC_TEST
	bool "Support Miscellaneous Test"
	depends on USB_HOST

if USB_FOR_MISC_TEST

config USB_MISC_TEST_DRAM_HIGHLOAD
	bool "Simulate DRAM Highload"
	help
	  Please skip the following DRAM range which has been used by other modules.

	  0x4000_0000 ~ 0x8000_0000 (HIK IMG)
	  0x9000_0000 ~ 0x9e00_0000 (VENC)
	  see "gdma_cfg_max" for detail (GDMA)

endif # USB_FOR_MISC_TEST

endmenu
```

## project/marsg2s/src/sys/usb/dwc2/Kconfig
```kconfig
config USB_DWC2
	bool "Designware USB2 DRD Core Support"

if USB_DWC2

choice
	bool "DWC2 Mode Selection"
	default USB_DWC2_DUAL_ROLE if (USB_HOST && USB_GADGET)
	default USB_DWC2_HOST if USB_HOST
	default USB_DWC2_GADGET if USB_GADGET

config USB_DWC2_HOST
	bool "Host only mode"
	depends on USB_HOST
	help
	  Select this when you want to use DWC2 in host mode only,
	  thereby the gadget feature will be regressed.

config USB_DWC2_GADGET
	bool "Gadget only mode"
	depends on USB_GADGET
	help
	  Select this when you want to use DWC2 in gadget mode only,
	  thereby the host feature will be regressed.

config USB_DWC2_DUAL_ROLE
	bool "Dual Role mode"
	depends on (USB_HOST && USB_GADGET)
	help
	  This is the default mode of working of DWC2 controller where
	  both host and gadget features are enabled.

endchoice

config USB_DWC2_REG_BASE
	hex "DWC2 Register Base Address"
	default 0x14000000

config USB_DWC2_SGDMA
	bool "Enable Scatter/Gather DMA mode"
	help
	  Use scatter/gather DMA mode if select this option.
	  Otherwise, buffer DMA mode is used by default.

config USB_DWC2_FS
	bool "Limit to Full-Speed"
	help
	  Limit the transfer speed to Full-Speed if select this option.
	  Otherwise, it will automatically negotiate to High-Speed.

	  Host mode may not support to force limit to Full-Speed. 

config USB_DWC2_DEBUG
	bool "Enable Debugging Message"
	help
	  Say Y here to enable debugging messages in the DWC2 Driver.

config USB_DWC2_DEBUG_TOOL
	bool "Support Debug Tool"
	select USB_DEBUG_TOOL
	help
	  Say Y here to support debug tool in the DWC2 Driver.

endif # USB_DWC2
```

## project/marsg2s/src/sys/usb/dwc3/Kconfig
```kconfig
config USB_DWC3
	bool "DesignWare USB3 DRD Core Support"

if USB_DWC3

choice
	bool "DWC3 Mode Selection"
	default USB_DWC3_DUAL_ROLE if (USB_HOST && USB_GADGET)
	default USB_DWC3_HOST if USB_HOST
	default USB_DWC3_GADGET if USB_GADGET

config USB_DWC3_HOST
	bool "Host only mode"
	depends on USB_HOST
	help
	  Select this when you want to use DWC3 in host mode only,
	  thereby the gadget feature will be regressed.

config USB_DWC3_GADGET
	bool "Gadget only mode"
	depends on USB_GADGET
	help
	  Select this when you want to use DWC3 in gadget mode only,
	  thereby the host feature will be regressed.

config USB_DWC3_DUAL_ROLE
	bool "Dual Role mode"
	depends on (USB_HOST && USB_GADGET)
	help
	  This is the default mode of working of DWC3 controller where
	  both host and gadget features are enabled.

endchoice

config USB_DWC3_REG_BASE
	hex "DWC3 Register Base Address"
	default 0x10c00000

config USB_DWC3_FAST_SIMULATION
	bool "Fast Simulation Support"
	default y if PLAT_COSIM

config USB_DWC3_DEBUG_BUS
	bool "DWC3 Debug Bus Support"

config USB_DWC3_QUIRK_VBUS
	bool "DWC3 Quirk VBUS Present Indicator"

endif # USB_DWC3
```

## project/marsg2s/src/sys/usb/gadget/Kconfig
```kconfig
menuconfig USB_GADGET
	bool "Support for Device-side USB"

if USB_GADGET

config USB_GADGET_ENABLE_U1U2
	bool "Enable U1/U2 Link State"
	default y

config USB_GADGET_VBUS_DRAW
	int "Maximum VBUS Power usage (2-500 mA)"
	range 2 500
	default 2

comment "USB Device Class drivers"

config USB_GADGET_CUSTOM
	bool "Custom"

config USB_GADGET_STORAGE
	bool "Mass Storage"

if USB_GADGET_STORAGE

config USB_GADGET_STORAGE_NUM_EPGRP
	int "Endpoint Number in Pairs"
	range 1 15
	default 1
	help
	  The group number of endpoint for bulk transfer. An IN endpoint and
	  an OUT endpoint form a group of endpoints.

	  As far as we known, dwc2 supports up to 6 groups of endpoints, 
	  dwc3 supports up to 9 groups of endpoints.

config USB_GADGET_STORAGE_NUM_BUFFERS
	int "Cache Buffer Number"
	default 32
	help
	  The number of buffers for bulk transfer.

config USB_GADGET_STORAGE_BUFFER_SIZE
	hex "Cache Buffer Size"
	default 0x4000
	help
	  The size of buffer for bulk transfer. Larger buffers may have
	  better R/W performance.
	  
	  As far as we known, the buffer size field in dwc3 TRB supports up
	  to (16MiB - 1).

config USB_GADGET_STORAGE_NUM_LUNS
	int "Logical Unit Number"
	default 1

config USB_GADGET_STORAGE_ADDR
	hex "LUN Address"
	default 0x27000000

config USB_GADGET_STORAGE_SIZE
	hex "LUN Size"
	default 0x8000000

endif # USB_GADGET_STORAGE

endif # USB_GADGET
```

## project/marsg2s/src/sys/usb/phy/Kconfig
```kconfig
config USB_PHY
	bool "USB PHY Support"
	default y

if USB_PHY

config USB_PHY_SSC
	bool "USB PHY SSC Support"
	help
	  This option will enable the SSC(Spread Spectrum Clock) of USB PHY.

endif
```

## project/marsg2x/raw/src/lib/Kconfig
```kconfig
menu "Library Configuration"

config TRACE
	bool "Trace System Running Support"

if TRACE

config TRACE_FUNC_DEPTH
	int "Trace Function Depth"
	default 32

endif

comment "Dynamic Memory Allocation Support"

config MEM_COPY
	bool "Use self mem_copy function"
	help
	  The library function 'memcpy' sometimes behaves abnormally.
	  So use self 'mem_copy' function to replace it.

config MEM_CLEAR
	bool "Use self mem_clear function"
	help
	  The library function 'memset' sometimes behaves abnormally.
	  So use self 'mem_clear' function to replace it.

config MEM_ALLOC_ADDR
	hex "Start address of dynamic memory allocation"
	default 0x20000000
	help
	  For MarsG2x:
	  iram: 0x0602_0000 ~ 0x0603_ffff
	  dram: 0x2000_0000 ~ 0xffff_ffff, 0x1_0000_0000 ~ 0x1_1fff_ffff,
	        0x1_2000_0000 ~ 0x1_ffff_ffff, 0x2_0000_0000 ~ 0x2_1fff_ffff

config MEM_ALLOC_SIZE
	hex "Total size for dynamic memory allocation"
	default 0x6000000

endmenu
```

## project/marsg2x/raw/src/sys/usb/Kconfig
```kconfig
menuconfig USB
	bool "USB Support"
	default y

if USB

source "src/sys/usb/host/Kconfig"
source "src/sys/usb/gadget/Kconfig"
source "src/sys/usb/phy/Kconfig"

config USB_PM
	bool "Support Power Management"
	default y if USB

config USB_TIMEOUT
	bool "Support Timeout Mechanism"
	default y
	help
	  If there is no timeout mechanism for data transfer, special circumstances
	  may cause the program to wait all the time.

	  If select this option, the program will automatically exit the wait after
	  data transmission timeout and continue to execute subsequent content

config USB_TIMEOUT_RATIO
	int "Zoom Ratio for Timeout Mechanism"
	depends on USB_TIMEOUT
	default 0 if PLAT_COSIM
	default 8 if PLAT_FPGA
	default 12 if PLAT_ASIC

comment "USB Imaging devices"

source "src/sys/usb/dwc2/Kconfig"
source "src/sys/usb/dwc3/Kconfig"

comment "USB miscellaneous options"

config USB_SKIP_CHK_HCPRIV
	bool "Sikp Check HC Private Data"
	default y if PLAT_COSIM

config USB_SKIP_MEM_CLEAR
	bool "Skip Clear Memory Buffer"
	default y if PLAT_COSIM

config USB_SKIP_EP0_REINIT
	bool "Skip Re-Initialize EP0"
	default y if PLAT_COSIM

config USB_PERFORMANCE
	bool "Support Performance Test"
	help
	  This option shall optimize the configuration to ensure that
	  the device can transfer data with optimal performance.

config USB_PRESSURE
	bool "Support Pressure Test"
	help
	  This option may modify part of the configuration to meet
	  the stress test requirements.

config USB_COMPLIANCE
	bool "Support Compliance Test"
	depends on USB_DWC3
	help
	  This option may have no effect on USB device mode. Generally,
	  Compliance mode is enabled on the device by default.

config USB_COMPLIANCE_ADVANCE
	bool "Auto Advance the Compliance Pattern"
	depends on USB_COMPLIANCE

config USB_TEST_PATTERN
	bool "Support Test Pattern for Eye etc."
	depends on USB_DWC2
	help
	  Default to send "Test_Packet" for testing eye pattern.

config USB_SWITCH_FREQUENCY
	bool "Support Switch Frequency Test"

config USB_POWER_CONSUME
	bool "Support Power Consume Test"

config USB_SLT
        bool "Support System Level Test"
        depends on USB_HOST

config USB_HTOL
	bool "Support High Termperature Operation Life Test"

config USB_ATE
	bool "Support Automatic Test Equipment"
	depends on USB_PHY

config USB_LOOPBACK
	bool "Support Loopback Test"
	depends on USB_PHY

if USB_LOOPBACK

config USB_LOOPBACK_EXTERNAL
	bool "Support External Loopback Test"

config USB_LOOPBACK_INTERNAL
	bool "Support Internal Loopback Test"

endif # USB_LOOPBACK

config USB_GADGET_HOTPLUG
	bool "Support Hotplug Test(FIXME)"
	depends on USB_GADGET

comment "USB debug options"

config USB_DISPLAY_REGOP
	bool "Print Regiter R/W Operations"

config USB_EXPORT_REGOP
	bool "Export Register R/W Operation"
	help
	  The user can directly perform the read-write operation
	  of the exported register by directly reading and writing
	  the register address.

config USB_DEBUG_TOOL
	bool

source "src/sys/usb/board/Kconfig"

endif # USB
```

## project/marsg2x/src/sys/usb/host/Kconfig
```kconfig
menuconfig USB_HOST
	bool "Support for Host-side USB"

if USB_HOST

config USB_XHCI_HCD
	bool "xHCI HCD (USB 3.0) Support"

if USB_XHCI_HCD

config USB_XHCI_REG_BASE
	hex "xHCI Regsiter Base Address"
	default 0x10c00000
	help
	  Start from HC capability registers

config USB_XHCI_REG_PORT_OFFSET
	hex "xHCI Port Register Offset"
	default 0x30
	help
	  MarsG2x doesn't follow xHCI Spec when calculating the register
	  address associated with port(eg. PORTSC...)
	  So an offset address needs to be added here to calculate the 
	  correct register address.

config USB_XHCI_MAX_INTR
	int "xHCI Interrupt Number"
	range 1 1024
	default 1

endif # USB_XHCI_HCD

endif # USB_HOST
```
